## nemu/configs/riscv32e-npc-ref_defconfig
```kconfig
CONFIG_ISA_riscv=y
CONFIG_RVE=y
CONFIG_ENGINE_INTERPRETER=y
CONFIG_MODE_SYSTEM=y
CONFIG_TARGET_NATIVE_ELF=y
# CONFIG_TRACE is not set
CONFIG_MBASE=0x80000000
CONFIG_MSIZE=0x8000000
CONFIG_PC_RESET_OFFSET=0
CONFIG_PMEM_MALLOC=y
# CONFIG_MEM_RANDOM is not set
CONFIG_DEVICE=y
CONFIG_HAS_SERIAL=y
CONFIG_SERIAL_MMIO=0xa00003f8
CONFIG_HAS_TIMER=y
CONFIG_RTC_MMIO=0xa0000048
# CONFIG_HAS_KEYBOARD is not set
# CONFIG_HAS_VGA is not set
# CONFIG_HAS_AUDIO is not set
# CONFIG_HAS_DISK is not set
CONFIG_RT_CHECK=y
```

## opensbi/platform/triathlon/Kconfig
```kconfig
config PLATFORM_TRIATHLON
	bool
	select IRQCHIP_PLIC
	select SERIAL_UART8250
	select TIMER_MTIMER
	default y
```
